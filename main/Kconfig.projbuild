## main/Kconfig.projbuild
```kconfig
menu "Alice Zigbee Aquarium Thermometer"
    config AQUARIUM_DATA_GPIO
        int "GPIO данных DS18B20"
        range 0 30
        default 4
    config AQUARIUM_LED_GPIO
        int "GPIO синего индикатора обнаружения (активный высокий)"
        range 0 30
        default 15
    config AQUARIUM_RGB_GPIO
        int "GPIO RGB WS2812"
        range 0 30
        default 8
    config AQUARIUM_RGB_BRIGHTNESS
        int "Яркость RGB (1–255)"
        range 1 255
        default 4
    config AQUARIUM_BOOT_GPIO
        int "GPIO кнопки сброса привязки (активный низкий уровень)"
        range 0 30
        default 9
    config AQUARIUM_SAMPLE_SECONDS
        int "Пауза между измерениями (секунды)"
        range 2 3600
        default 5
    config AQUARIUM_REPORT_SECONDS
        int "Период отправки показаний (секунды)"
        range 5 3600
        default 60
    config AQUARIUM_DELTA_CENTI
        int "Порог изменения для отправки (сотые доли градуса C)"
        range 1 1000
        default 20
endmenu
```
